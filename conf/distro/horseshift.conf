## conf/distro/horseshift.conf
```bitbake
DISTRO_NAME = "HorseSHIfT linux"
DISTRO_VERSION = "0.4"

# By default DISTRO_FEATURES is populated with bloatware. We don't want that,
# so set the features, don't append.
DISTRO_FEATURES = "opengl"

# mklibs-native does not compile on distris with GCC-11. This package is neither
# required, nor used. This is the way to disable it
USER_CLASSES:remove = "image-mklibs"

# More bloatware that otherwise gets added automatically
DISTRO_FEATURES_BACKFILL_CONSIDERED = "pulseaudio gobject-introspection-data ldconfig"

# Make sure mesa gets picked up as our OpenGL implementation
PREFERRED_PROVIDER_virtual/egl = "mesa"
PREFERRED_PROVIDER_virtual/libgles2 = "mesa"

# Make sure 'mesa' builds the GPU driver and display output driver
PACKAGECONFIG:append_pn-mesa = "etnaviv kmsro"
PACKAGECONFIG:remove_pn-mesa = "virgl"

# glmark2 doesn't declare its runtime dependencies on libegl and libgles2.
# Until that is fixed, "patch" it here.
#
RDEPENDS_glmark2 += "libegl libgles2"

# Enable TUI commands, such as 'layout'
PACKAGECONFIG:append_pn-gdb += "tui"
```

## conf/layer.conf
```bitbake
BBPATH .= ":${LAYERDIR}"
BBFILES += "${LAYERDIR}/recipes-*/*/*.bb \
	    ${LAYERDIR}/recipes-*/*/*.bbappend"

BBFILE_COLLECTIONS += "horseshift-linux"
BBFILE_PATTERN_horseshift-linux := "^${LAYERDIR}/"
BBFILE_PRIORITY_horseshift-linux = "9"
LAYERSERIES_COMPAT_horseshift-linux = "dunfell"
```

## conf/machine/stm32mp1.conf
```bitbake
DEFAULTTUNE = "cortexa7thf-neon-vfpv4"
include conf/machine/include/tune-cortexa7.inc

DEVICETREES = "stm32mp157c-ev1 stm32mp157c-dk2"
SERIAL_CONSOLE = "2000000 ttySTM0"

#
# u-boot configs are specified as a triplet:
#    UBOOT_CONFIG[<name>]   = "<defconfig>,<??>,u-boot.img"
#
UBOOT_CONFIG += "nonsec"
UBOOT_CONFIG[nonsec] = "stm32mp15_basic_defconfig,,u-boot.img"
UBOOT_DEVICETREES = "${DEVICETREES}"
UBOOT_ENTRYPOINT = "0xc2000040"

#
# kernel configs
#
PREFERRED_PROVIDER_virtual/kernel = "linux-stm32mp"
KERNEL_IMAGETYPES = "uImage zImage"
KERNEL_DEVICETREE = "${@' '.join([dtb + '.dtb' for dtb in d.getVar('DEVICETREES').split()])}"
KERNEL_UIMAGE_LOADADDRESS = "${UBOOT_ENTRYPOINT}"
KERNEL_BOOTARGS = "root=PARTUUID=e91c4e10-16e6-4c0e-bd0e-77becf4a3582 init=/bin/fastinit"

DEVICETREE_OVERLAYS[stm32mp157c-ev1]="bootargs"
DEVICETREE_OVERLAYS[stm32mp157c-dk2]="bootargs dk2-can1-enable dk2-optee"
```
